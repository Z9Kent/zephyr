## soc/arm/atmel_sam0/saml22/Kconfig.defconfig.series
```kconfig
# Atmel SAML MCU series configuration options
# KBH 08/17/2023
# Copyright (c) 2021 Argentum Systems Ltd.
# SPDX-License-Identifier: Apache-2.0

if SOC_SERIES_SAML22

config SOC_SERIES
	default "saml22"

config SOC_PART_NUMBER
	default "saml22g16a" if SOC_PART_NUMBER_SAML22G16A
	default "saml22g17a" if SOC_PART_NUMBER_SAML22G17A
	default "saml22g18a" if SOC_PART_NUMBER_SAML22G18A
	default "saml22j16a" if SOC_PART_NUMBER_SAML22J16A
	default "saml22j17a" if SOC_PART_NUMBER_SAML22J17A
	default "saml22j18a" if SOC_PART_NUMBER_SAML22J18A
	default "saml22n16a" if SOC_PART_NUMBER_SAML22N16A
	default "saml22n17a" if SOC_PART_NUMBER_SAML22N17A
	default "saml22n18a" if SOC_PART_NUMBER_SAML22N18A

config NUM_IRQS
	default 27

config SYS_CLOCK_HW_CYCLES_PER_SEC
	default	$(dt_node_int_prop_int,/cpus/cpu@0,clock-frequency)

endif # SOC_SERIES_SAML22
```

## soc/arm/atmel_sam0/saml22/Kconfig.series
```kconfig
# Atmel SAML22 MCU series
# KBH 08/17/2023
# Copyright (c) 2021 Argentum Systems Ltd.
# Copyright (c) 2023 Gerson Fernando Budke <nandojve@gmail.com>
# SPDX-License-Identifier: Apache-2.0

config SOC_SERIES_SAML22
	bool "Atmel SAML22 MCU"
	select ARM
	select CPU_CORTEX_M0PLUS
	select CPU_CORTEX_M_HAS_SYSTICK
	select CPU_CORTEX_M_HAS_VTOR
	select SOC_FAMILY_SAM0
	select PLATFORM_SPECIFIC_INIT
	select ASF
	select SOC_ATMEL_SAML_OSC
	help
	  Enable support for Atmel SAML22 Cortex-M0+ microcontrollers.
```

## soc/arm/atmel_sam0/saml22/Kconfig.soc
```kconfig
# Atmel SAML MCU series

# Copyright (c) 2021 Argentum Systems Ltd.
# SPDX-License-Identifier: Apache-2.0

choice
	prompt "Atmel SAML22 MCU Selection"
	depends on SOC_SERIES_SAML22

config SOC_PART_NUMBER_SAML22G16A
	bool "SAML22G16A"

config SOC_PART_NUMBER_SAML22G17A
	bool "SAML22G17A"

config SOC_PART_NUMBER_SAML22G18A
	bool "SAML22G18A"

config SOC_PART_NUMBER_SAML22J16A
	bool "SAML22J16A"

config SOC_PART_NUMBER_SAML22J17A
	bool "SAML22J17A"

config SOC_PART_NUMBER_SAML22J18A
	bool "SAML22J18A"

config SOC_PART_NUMBER_SAML22N16A
	bool "SAML22N16A"

config SOC_PART_NUMBER_SAML22N17A
	bool "SAML22N17A"

config SOC_PART_NUMBER_SAML22N18A
	bool "SAML22N18A"


endchoice
```

## src/controller/aes-gcm/Kconfig
```kconfig
menu "Z9 Crypto"

config Z9_GCM_C
    bool "Enable Software GCM"
    default n

endmenu

      
```

## src/controller/boards/arm/atsaml22_xpro/atsaml22_xpro_defconfig
```kconfig
# Copyright (c) 2021 Argentum Systems Ltd.
# KBH 08/17/2023
# SPDX-License-Identifier: Apache-2.0

CONFIG_SOC_SERIES_SAML22=y
CONFIG_SOC_PART_NUMBER_SAML22N18A=y
CONFIG_SOC_ATMEL_SAML_XOSC32K=y
CONFIG_SOC_ATMEL_SAML_XOSC32K_AS_MAIN=y
CONFIG_BOARD_ATSAML22_XPRO=y
CONFIG_BUILD_OUTPUT_HEX=y

CONFIG_CONSOLE=y
CONFIG_GPIO=y
CONFIG_SERIAL=y
CONFIG_UART_CONSOLE=y
CONFIG_UART_INTERRUPT_DRIVEN=y
```

## src/controller/boards/arm/wl_athena/Kconfig.board
```kconfig
# update KBH 8/17/2023
# SAM L22 Xplained Pro board configuration

# Copyright (c) 2021 Argentum Systems Ltd.
# SPDX-License-Identifier: Apache-2.0

config BOARD_WAVELYNX_ATHENA
	bool "WaveLynx Athena Controller"
	depends on SOC_PART_NUMBER_SAML22G17A
```

## src/manifest-repo/west.yml
```yaml
# The west manifest file for zephyrproject-rtos Zephyr.
#
# The per-installation west configuration file, .west/config, sets the
# path to the project containing this file in the [manifest] section's
# "path" variable.
#
# You are free to create your own manifest files and put them in any
# repository you want, to create your own custom Zephyr installations.
# For example, you could create a manifest file in your own out of
# tree application directory, which would pull this zephyr repository
# in as an ordinary project.
#
# You can pass your manifest repositories to west init when creating a
# new Zephyr installation. See the west documentation for more
# information.

manifest:
  defaults:
    remote: zephyrproject-rtos

  remotes:
    - name: zephyrproject-rtos
      url-base: https://github.com/zephyrproject-rtos
    - name: meta
      url-base: https://github.com/ericniebler
    - name: babblesim
      url-base: https://github.com/BabbleSim
    - name: z9-lock
      url-base: https://bitbucket.org/z9security
    - name: z9-kent
      url-base: git@github.com:z9Kent

  group-filter: [-babblesim, -optional]

  #
  # Please add items below based on alphabetical order
  projects:
    - name: zephyr
      remote: z9-kent
      revision: v3.5.0
      west-commands: scripts/west-commands.yml
      import: true
    - name: meta
      remote: meta
      path: modules/meta
    - name: hal_atmel
      remote: z9-kent 
      path: modules/hal/atmel
      groups:
        - hal

  self:
    path: manifest-repo
```

## src/z9-zephyr/Kconfig.z9
```kconfig
menu "Z9-Lock"
config Z9_READER
    bool "Enable Reader"
    default n

config Z9_CONTROLLER
    bool "Enable Controller"
    default n

#rsource "aes-gcm/Kconfig"
rsource "ble/Kconfig"
rsource "nfc/Kconfig"

endmenu
```

## src/z9-zephyr/boards/arm/atsaml22_xpro/Kconfig.board
```kconfig
# update KBH 8/17/2023
# SAM L22 Xplained Pro board configuration

# Copyright (c) 2021 Argentum Systems Ltd.
# SPDX-License-Identifier: Apache-2.0

config BOARD_ATSAML22_XPRO
	bool "SAM L22 Xplained Pro"
	depends on SOC_PART_NUMBER_SAML22N18A
```

## src/z9-zephyr/boards/arm/atsaml22_xpro/Kconfig.defconfig
```kconfig
# SAM L22 Xplained Pro board configuration
# KBH 8/17/2023

# Copyright (c) 2021 Argentum Systems Ltd.
# SPDX-License-Identifier: Apache-2.0

config BOARD
	default "atsaml22_xpro"
	depends on BOARD_ATSAML22_XPRO
```

## src/z9-zephyr/boards/arm/wl_athena/Kconfig.defconfig
```kconfig
# SAM L22 Xplained Pro board configuration
# KBH 8/17/2023

# Copyright (c) 2021 Argentum Systems Ltd.
# SPDX-License-Identifier: Apache-2.0

config BOARD
	default "wl_athena"
	depends on BOARD_WAVELYNX_ATHENA
```

## src/z9-zephyr/boards/arm/wl_athena/wl_athena_defconfig
```kconfig
# Copyright (c) 2021 Argentum Systems Ltd.
# KBH 08/17/2023
# SPDX-License-Identifier: Apache-2.0

CONFIG_SOC_SERIES_SAML22=y
CONFIG_SOC_PART_NUMBER_SAML22G17A=y
CONFIG_SOC_ATMEL_SAML_XOSC32K=y
CONFIG_SOC_ATMEL_SAML_XOSC32K_AS_MAIN=y
CONFIG_BOARD_WAVELYNX_ATHENA=y
CONFIG_BUILD_OUTPUT_HEX=y

CONFIG_CONSOLE=n
CONFIG_GPIO=y
CONFIG_SERIAL=y
CONFIG_UART_CONSOLE=n
CONFIG_UART_INTERRUPT_DRIVEN=y

CONFIG_FLASH_SIZE=128
CONFIG_SRAM_SIZE=16
```
